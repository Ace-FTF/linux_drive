
/dts-v1/;

#include <dt-bindings/input/input.h>
#include "imx6ull.dtsi"

/ {
    model = "Freescale i.MX6 ULL 14x14 EVK Board";
    compatible = "fsl,imx6ull-14x14-evk", "fsl,imx6ull";



    /* KEY功能分割线：***********************************************************************************************************************************/
    /* KEY_step2 */
    lsykey {
        #address-cells = <1>;
        #size-cells = <1>;
        compatible = "atkalpha-gpiokey";
        pinctrl-names = "default";
        pinctrl-0 = <&pinctrl_lsykey>;
        key-gpio = <&gpio1 18 GPIO_ACTIVE_LOW>;
        status = "okay";
    };
    /* KEY_step2 end */
    /* KEY_step3. 【同LED_step3一样】，注释掉系统默认GPIO5 IO01的默认功能！ */

}

&iomuxc {

    
	imx6ul-evk {

        /* KEY_step1 */
        pinctrl_lsykey: lsykeygrp {
            fsl,pins = <
               MX6UL_PAD_UART1_CTS_B__GPIO1_IO18 0xF080
            >;
        };
        /* KEY_step1 end */



};


